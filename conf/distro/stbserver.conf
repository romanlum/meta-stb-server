## conf/distro/stbserver.conf
```bitbake
#@TYPE: Distribution
#@NAME: StbServer
#@DESCRIPTION: Embedded Linux Distribution Configuration for STB`s used as tv server

DISTRO_NAME ?= "stbserver"
DISTRO_VERSION = "1.0"
BUILD_VERSION = "001"
DEVELOPER_BUILD_VERSION = "001"
BB_HASH_IGNORE_MISMATCH = "1"
DEFAULT_TIMEZONE = "Europe/London"

E2DEFAULTSKIN = "enigma2-plugin-skins-openvix-vix-night-hd"

ENIGMA2_URI ?= "${@bb.utils.contains("DISTRO_TYPE", "release", "git://github.com/OpenViX/enigma2.git;protocol=git" , "git://github.com/OpenViX/enigma2.git;protocol=git;branch=Dev", d)}"
ENIGMA2_URI_dm900 ?= "git://github.com/OpenViX/enigma2.git;protocol=git;branch=dreambox"
ENIGMA2_URI_odroidc2 ?= "git://github.com/OpenViX/enigma2.git;protocol=git;branch=amlogic"
ENIGMA2_SKINS_URI ?= "git://github.com/OpenViX/enigma2-skins.git;protocol=git"
# ENIGMA2_PLUGINS_URI = "git://github.com/oe-alliance/enigma2-plugins.git;protocol=git;branch=master"

# git
SRCREV_pn-enigma2-plugin-skins-magic ?= "${AUTOREV}"
SRCREV_pn-enigma2 ?= "${AUTOREV}"
SRCREV_pn-aio-grab ?= "${AUTOREV}"
SRCREV_pn-ambx ?= "${AUTOREV}"
SRCREV_pn-python-pyambx ?= "${AUTOREV}"
SRCREV_pn-enigma2-plugin-extensions-ambx ?= "${AUTOREV}"
SRCREV_pn-enigma2-pliplugins ?= "${AUTOREV}"
SRCREV_pn-enigma2-plugin-extensions-epgimport ?= "${AUTOREV}"
SRCREV_pn-enigma2-plugin-skins-pli-hd ?= "${AUTOREV}"
SRCREV_pn-enigma2-plugin-skins-pli-scale-hd ?= "${AUTOREV}"
SRCREV_pn-enigma2-plugins ?= "${AUTOREV}"
SRCREV_pn-enigma2-skins ?= "${AUTOREV}"
SRCREV_pn-hotplug-e2-helper ?= "${AUTOREV}"
SRCREV_pn-libdreamdvd ?= "${AUTOREV}"
SRCREV_pn-usbtunerhelper ?= "${AUTOREV}"
SRCREV_pn-libtuxtxt ?= "${AUTOREV}"
SRCREV_pn-tuxtxt-enigma2 ?= "${AUTOREV}"
SRCREV_pn-librtmp ?= "${AUTOREV}"
SRCREV_pn-hamsterdb ?= "${AUTOREV}"
SRCREV_pn-gstreamer1.0-plugin-subsink ?= "${AUTOREV}"
SRCREV_pn-gstreamer1.0-plugin-dvbmediasink ?= "${AUTOREV}"

HENKSAT_GITREV ?= "${AUTOREV}"
SRCREV_pn-enigma2-plugin-settings-henksat-19e ?= "${HENKSAT_GITREV}"
SRCREV_pn-enigma2-plugin-settings-henksat-23e ?= "${HENKSAT_GITREV}"
SRCREV_pn-enigma2-plugin-settings-henksat-13e-19e ?= "${HENKSAT_GITREV}"
SRCREV_pn-enigma2-plugin-settings-henksat-19e-23e ?= "${HENKSAT_GITREV}"
SRCREV_pn-enigma2-plugin-settings-henksat-19e-23e-28e ?= "${HENKSAT_GITREV}"
SRCREV_pn-enigma2-plugin-settings-henksat-13e-19e-23e-28e ?= "${HENKSAT_GITREV}"
SRCREV_pn-enigma2-plugin-settings-henksat-wavefrontier ?= "${HENKSAT_GITREV}"
SRCREV_pn-enigma2-plugin-settings-henksat-rotating ?= "${HENKSAT_GITREV}"
SRCREV_pn-enigma2-plugin-settings-henksat-13e-19e-23e-28e-4.8e-0.8w ?= "${HENKSAT_GITREV}"
SRCREV_pn-enigma2-plugin-settings-henksat-13e-19e-23e-28e-42e-7e ?= "${HENKSAT_GITREV}"
SRCREV_pn-enigma2-plugin-settings-henksat-ziggo ?= "${HENKSAT_GITREV}"

HANS_GITREV ?= "${AUTOREV}"
SRCREV_pn-enigma2-plugin-settings-hans-19e-23e ?= "${HANS_GITREV}"
SRCREV_pn-enigma2-plugin-settings-hans-19e-23e-28e ?= "${HANS_GITREV}"
SRCREV_pn-enigma2-plugin-settings-hans-9e-13e-19e-23e-28e ?= "${HANS_GITREV}"
SRCREV_pn-enigma2-plugin-settings-hans-9e-13e-19e-23e-28e-rotating ?= "${HANS_GITREV}"

# svn
SRCREV_pn-tuxbox-common ?= "${AUTOREV}"
SRCREV_pn-dvbsnoop ?= "${AUTOREV}"
SRCREV_pn-tuxterm ?= "${AUTOREV}"
SRCREV_pn-enigma2-plugin-extensions-tuxcom ?= "${AUTOREV}"
SRCREV_pn-enigma2-plugin-extensions-tuxterm ?= "${AUTOREV}"
SRCREV_pn-oscam-experimental ?= "7365"
SRCREV_pn-oscam-unstable = "6089"
SRCREV_pn-oscam-util-list-smargo = "7363"

RYTECSETTINGS_SRCDATE ?= "20120614"
SRCDATE_enigma2-plugin-settings-rytec-13e19e23e28e ?= "${RYTECSETTINGS_SRCDATE}"
SRCDATE_enigma2-plugin-settings-rytec-motor ?= "${RYTECSETTINGS_SRCDATE}"

IPKG_VARIANT = "opkg"

FEED_NAME ?= "${DISTRO_NAME}-${DISTRO_VERSION}"
DISTRO_FEED_URI ?= "${@bb.utils.contains("DISTRO_TYPE", "release", "http://www.notthere.io/feeds/${DISTRO_NAME}/${DISTRO_TYPE}/${DISTRO_VERSION}/${MACHINE}" , "http://notthere.org/feeds/${DISTRO_NAME}/${DISTRO_TYPE}/${DISTRO_VERSION}/${MACHINE}", d)}"
DISTRO_FEED_PREFIX ?= "${DISTRO_NAME}"

IMAGE_VERSION = "${DISTRO_VERSION}"
IMAGE_BUILD = "${@bb.utils.contains("DISTRO_TYPE", "release", "${BUILD_VERSION}" , "${BUILD_VERSION}.${DEVELOPER_BUILD_VERSION}", d)}"
IMAGE_NAME = "${@bb.utils.contains("DISTRO_TYPE", "release", "${DISTRO_NAME}-${IMAGE_VERSION}.${BUILD_VERSION}.${DISTRO_TYPE}-${MACHINEBUILD}", "${DISTRO_NAME}-${IMAGE_VERSION}.${BUILD_VERSION}.${DEVELOPER_BUILD_VERSION}.${DISTRO_TYPE}-${MACHINEBUILD}", d)}"
IMAGE_VER_STRING = "${DISTRO_NAME}-${IMAGE_VERSION}.${BUILD_VERSION}.${DISTRO_TYPE}-${MACHINEBUILD}"
IMAGE_ROOTFS = "${TMPDIR}/rootfs"
IMAGE_LINK_NAME = ""
DEPLOY_DIR ?= "${TMPDIR}/deploy"

# for compatibility with rm_old_work.bbclass
WORKDIR = "${TMPDIR}/work/${MULTIMACH_TARGET_SYS}/${PN}/${PF}"

#USER_CLASSES += "image-prelink"
# SANITY_REQUIRED_UTILITIES = "patch diffstat texi2html makeinfo svn bzip2 tar gzip gawk chrpath wget cpio sshpass"
# INHERIT += "buildhistory recipe_sanity testlab"
# BUILDHISTORY_COMMIT = "1"

VIRTUAL-RUNTIME_dev_manager = "busybox-mdev"
VIRTUAL-RUNTIME_login_manager = "busybox"
VIRTUAL-RUNTIME_init_manager = "sysvinit"
VIRTUAL-RUNTIME_initscripts = "initscripts"

PREFERRED_PROVIDERS += "virtual/${TARGET_PREFIX}gcc-initial:gcc-cross-initial"
PREFERRED_PROVIDERS += "virtual/${TARGET_PREFIX}gcc-intermediate:gcc-cross-intermediate"
PREFERRED_PROVIDERS += "virtual/${TARGET_PREFIX}gcc:gcc-cross"
PREFERRED_PROVIDERS += "virtual/${TARGET_PREFIX}g++:gcc-cross"

# OE optimization defaults to -O2 which makes for much larger binaries.
# Override here to use -Os instead, resulting in smaller images.
FULL_OPTIMIZATION = "-Os -pipe ${DEBUG_FLAGS}"
# build some core libs with better compiler optimization for better performance
O3_OPT = "-O3 -pipe ${DEBUG_FLAGS}"
FULL_OPTIMIZATION_pn-flac = "${O3_OPT}"
FULL_OPTIMIZATION_pn-jpeg = "${O3_OPT}"
FULL_OPTIMIZATION_pn-lame = "${O3_OPT}"
FULL_OPTIMIZATION_pn-liba52 = "${O3_OPT}"
FULL_OPTIMIZATION_pn-libdca = "${O3_OPT}"
FULL_OPTIMIZATION_pn-libgcrypt = "${O3_OPT}"
FULL_OPTIMIZATION_pn-libmad = "${O3_OPT}"
FULL_OPTIMIZATION_pn-libogg = "${O3_OPT}"
FULL_OPTIMIZATION_pn-libpng = "${O3_OPT}"
FULL_OPTIMIZATION_pn-libsamplerate = "${O3_OPT}"
FULL_OPTIMIZATION_pn-libvorbis = "${O3_OPT}"
FULL_OPTIMIZATION_pn-tremor = "${O3_OPT}"
FULL_OPTIMIZATION_pn-zlib = "${O3_OPT}"

PYTHON_BASEVERSION ?= "2.7"
PREFERRED_VERSION_python ?= "2.7.16"
PREFERRED_VERSION_python-native ?= "2.7.16"

PREFERRED_PROVIDER_virtual/cron = "busybox"
PREFERRED_RPROVIDER_virtual/cron = "busybox"

PREFERRED_VERSION_netatalk ?= "2.2.3"

DISTRO_FEATURES = "${DISTRO_FEATURES_EXTRA} bluez5 directfb gtk-directfb pulseaudio alsa argp bluetooth ext2 ipv4 ipv6 irda largefile mplt pcmcia wifi wifi-extra xattr nfs zeroconf pci pam libsigc2"

QA_LOG = "1"
QA_LOGFILE = "${TMPDIR}/qa.log"

OEINCLUDELOGS ?= "yes"
KERNEL_CONSOLE ?= "ttyS0,115200n8"

BB_GENERATE_MIRROR_TARBALLS ??= "0"

NO32LIBS ??= "1"

# Missing checksums should raise an error
BB_STRICT_CHECKSUM = "0"

TCLIBCAPPEND = ""

# Drop unused PACKAGE_EXTRA_ARCHS
PACKAGE_EXTRA_ARCHS = "${TUNE_PKGARCH} ${OEM_ARCH}"

# add support for extra feeds
PACKAGE_ARCHS += " 3rdparty ${MACHINE}_3rdparty private"

LICENSE_FLAGS_WHITELIST = "commercial"
COMMERCIAL_AUDIO_PLUGINS ?= "gstreamer1.0-plugins-ugly-mad"
COMMERCIAL_VIDEO_PLUGINS ?= "gstreamer1.0-plugins-ugly-mpeg2dec"
```

## conf/layer.conf
```bitbake
# We have a conf and classes directory, add to BBPATH
BBPATH .= ":${LAYERDIR}"

# We have a packages directory, add to BBFILES
BBFILES += "${LAYERDIR}/recipes-*/*/*.bb \
            ${LAYERDIR}/recipes-*/*/*.bbappend"

BBFILE_COLLECTIONS += "stb-server"
BBFILE_PATTERN_stb-server := "^${LAYERDIR}/"
BBFILE_PRIORITY_stb-server = "4"

LAYERSERIES_COMPAT_stb-server = "warrior zeus"
```
